## Schaltuhr/sdkconfig.defaults
```kconfig
CONFIG_BOOTLOADER_LOG_LEVEL_WARN=y
CONFIG_ESPTOOLPY_FLASHSIZE_4MB=y
CONFIG_PARTITION_TABLE_CUSTOM=y
CONFIG_PARTITION_TABLE_CUSTOM_FILENAME="partitions_example.csv"
CONFIG_EXAMPLE_WIFI_SSID="mux"
CONFIG_EXAMPLE_WIFI_PASSWORD="uuz63CUAXPs4BKLLAHnpMcFVX3MGcOUTZqr8mBkRiGd1pYMEpdWgxAu9vtjnAiu"
# CONFIG_SPI_MASTER_ISR_IN_IRAM is not set
# CONFIG_SPI_SLAVE_ISR_IN_IRAM is not set
CONFIG_ESP32_DEFAULT_CPU_FREQ_80=y
# CONFIG_ESP32_DEBUG_OCDAWARE is not set
CONFIG_PM_ENABLE=y
CONFIG_ESP_MAIN_TASK_STACK_SIZE=7168
# CONFIG_ETH_USE_ESP32_EMAC is not set
# CONFIG_ETH_USE_SPI_ETHERNET is not set
# CONFIG_ESP_HTTP_CLIENT_ENABLE_HTTPS is not set
# CONFIG_ESP32_WIFI_ENABLE_WPA3_SAE is not set
# CONFIG_ESP32_PHY_CALIBRATION_AND_DATA_STORAGE is not set
CONFIG_FREERTOS_USE_TICKLESS_IDLE=y
CONFIG_FREERTOS_IDLE_TIME_BEFORE_SLEEP=2
CONFIG_LWIP_LOCAL_HOSTNAME="esp32-02"
# CONFIG_MQTT_PROTOCOL_311 is not set
# CONFIG_MQTT_TRANSPORT_SSL is not set
# CONFIG_MQTT_TRANSPORT_WEBSOCKET is not set
# CONFIG_VFS_SUPPORT_IO is not set
```

## i2c_tools/main/Kconfig.projbuild
```kconfig
menu "Example Configuration"

    config EXAMPLE_STORE_HISTORY
        bool "Store command history in flash"
        default n
        help
            Linenoise line editing library provides functions to save and load
            command history. If this option is enabled, initalizes a FAT filesystem
            and uses it to store command history.
endmenu

menu "APP Configuration"

    choice SNTP_TIME_SYNC_METHOD
        prompt "Time synchronization method"
        default SNTP_TIME_SYNC_METHOD_IMMED
        help
            Time synchronization method.

        config SNTP_TIME_SYNC_METHOD_IMMED
            bool "update time immediately when received"
        config SNTP_TIME_SYNC_METHOD_SMOOTH
            bool "update time with smooth method (adjtime)"
        config SNTP_TIME_SYNC_METHOD_CUSTOM
            bool "custom implementation"
    endchoice

endmenu
menu "UDP Logging"

config LOG_UDP_PORT
    int "UDP Port" 
    default 1337
    help
        UDP Port to send log output to

config LOG_UDP_IP
    string "IP address to send log output"
	default "224.0.0.0"
	help
		IP address to send log output to
endmenu
```
